#include "stm32f103xb.h"
#include "I2C driver.h"
#include "oled.h"

/*==========================================================
 * SSD1306 I2C ADDRESS
 *=========================================================*/
#define OLED_I2C_ADDRESS                 0x3C


/*==========================================================
 * SSD1306 CONTROL BYTES
 *=========================================================*/
#define OLED_CONTROL_COMMAND             0x00
#define OLED_CONTROL_DATA                0x40


/*==========================================================
 * DISPLAY CONTROL
 *=========================================================*/
#define OLED_DISPLAY_OFF                 0xAE
#define OLED_DISPLAY_ON                  0xAF
#define OLED_DISPLAY_RESUME_RAM          0xA4
#define OLED_DISPLAY_ALL_ON              0xA5
#define OLED_DISPLAY_NORMAL              0xA6
#define OLED_DISPLAY_INVERT              0xA7


/*==========================================================
 * MEMORY ADDRESSING
 *=========================================================*/
#define OLED_SET_MEMORY_MODE             0x20
#define OLED_SET_COLUMN_ADDRESS          0x21
#define OLED_SET_PAGE_ADDRESS            0x22


/*==========================================================
 * PAGE ADDRESS COMMANDS
 *=========================================================*/
#define OLED_PAGE_0                      0xB0
#define OLED_PAGE_1                      0xB1
#define OLED_PAGE_2                      0xB2
#define OLED_PAGE_3                      0xB3
#define OLED_PAGE_4                      0xB4
#define OLED_PAGE_5                      0xB5
#define OLED_PAGE_6                      0xB6
#define OLED_PAGE_7                      0xB7


/*==========================================================
 * DISPLAY CONFIGURATION
 *=========================================================*/
#define OLED_SET_START_LINE              0x40
#define OLED_SET_CONTRAST                0x81
#define OLED_SEGMENT_REMAP               0xA1
#define OLED_SET_MULTIPLEX_RATIO         0xA8
#define OLED_COM_SCAN_DEC                0xC8
#define OLED_SET_DISPLAY_OFFSET          0xD3
#define OLED_SET_DISPLAY_CLOCK_DIV       0xD5
#define OLED_SET_PRECHARGE_PERIOD        0xD9
#define OLED_SET_COM_PINS_CONFIG         0xDA
#define OLED_SET_VCOMH_LEVEL             0xDB
#define OLED_SET_CHARGE_PUMP             0x8D


/*==========================================================
 * SCROLLING
 *=========================================================*/
#define OLED_SCROLL_RIGHT                0x26
#define OLED_SCROLL_LEFT                 0x27
#define OLED_SCROLL_VERTICAL_RIGHT       0x29
#define OLED_SCROLL_VERTICAL_LEFT        0x2A
#define OLED_SCROLL_DEACTIVATE           0x2E
#define OLED_SCROLL_ACTIVATE             0x2F

/*==========================================================
 * MEMORY ADDRESSING MODES
 *=========================================================*/
#define OLED_HORIZONTAL_ADDRESSING       0x00
#define OLED_VERTICAL_ADDRESSING         0x01
#define OLED_PAGE_ADDRESSING             0x02


// standard ascii 5x7 font
// defines ascii characters 0x20-0x7F (32-127)
static const uint8_t Font5x7[] = {
	0x00, 0x00, 0x00, 0x00, 0x00,// (space)
	0x00, 0x00, 0x5F, 0x00, 0x00,// !
	0x00, 0x07, 0x00, 0x07, 0x00,// "
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	0x08, 0x1C, 0x2A, 0x08, 0x08 // <-
};

void OLED_Init(void);
void OLED_SendCommand_V1(uint8_t command);
void OLED_SendCommand_V2(uint8_t command, uint8_t value);
void OLED_SendCommand_V3(uint8_t command, uint8_t value1,uint8_t value2);
void OLED_SendData(const uint8_t *buffer);
void OLED_ClearBuffer(void);
void OLED_UpdateScreen(void);
const uint8_t *Font5x7_add(char c);



uint8_t OLED_FrameBuffer[1024];
uint8_t *OLED_Frame_ptr = OLED_FrameBuffer;
uint8_t *OLED_BufferPage_ptr = OLED_FrameBuffer;


void OLED_Init(void)
{
    I2C1_Init();

    OLED_SendCommand_V1(OLED_DISPLAY_OFF);

    OLED_SendCommand_V2(OLED_SET_DISPLAY_CLOCK_DIV, 0x80);

    OLED_SendCommand_V2(OLED_SET_MULTIPLEX_RATIO, 0x3F);

    OLED_SendCommand_V2(OLED_SET_DISPLAY_OFFSET, 0x00);

    OLED_SendCommand_V1(OLED_SET_START_LINE);

    OLED_SendCommand_V2(OLED_SET_CHARGE_PUMP, 0x14);

    OLED_SendCommand_V2(OLED_SET_MEMORY_MODE, OLED_HORIZONTAL_ADDRESSING);

    OLED_SendCommand_V1(OLED_SEGMENT_REMAP);

    OLED_SendCommand_V1(OLED_COM_SCAN_DEC);

    OLED_SendCommand_V2(OLED_SET_COM_PINS_CONFIG, 0x12);

    OLED_SendCommand_V2(OLED_SET_CONTRAST, 0xCF);

    OLED_SendCommand_V2(OLED_SET_PRECHARGE_PERIOD, 0xF1);

    OLED_SendCommand_V2(OLED_SET_VCOMH_LEVEL, 0x40);

    OLED_SendCommand_V1(OLED_DISPLAY_RESUME_RAM);

    OLED_SendCommand_V1(OLED_DISPLAY_NORMAL);

    OLED_SendCommand_V1(OLED_DISPLAY_ON);

}

void OLED_SendCommand_V1(uint8_t command)
{
    I2C1_Start();

    I2C1_SendAddress(OLED_I2C_ADDRESS,0);

    I2C1_SendByte(OLED_CONTROL_COMMAND);

    I2C1_SendByte(command);

    I2C1_Stop();
}

void OLED_SendCommand_V2(uint8_t command, uint8_t value)
{
    I2C1_Start();

    I2C1_SendAddress(OLED_I2C_ADDRESS,0);

    I2C1_SendByte(OLED_CONTROL_COMMAND);

    I2C1_SendByte(command);

    I2C1_SendByte(value);

    I2C1_Stop();
}
void OLED_SendCommand_V3(uint8_t command, uint8_t value1,uint8_t value2)
{
    I2C1_Start();

    I2C1_SendAddress(OLED_I2C_ADDRESS,0);

    I2C1_SendByte(OLED_CONTROL_COMMAND);

    I2C1_SendByte(command);

    I2C1_SendByte(value1);

    I2C1_SendByte(value2);

    I2C1_Stop();
}

void OLED_SendData(const uint8_t *buffer)
{
    I2C1_Start();

    I2C1_SendAddress(OLED_I2C_ADDRESS, I2C_WRITE);

    I2C1_SendByte(OLED_CONTROL_DATA);

    for(uint16_t i = 0; i < 1024; i++)
    {
        I2C1_SendByte(*buffer);
		buffer++;
    }

    I2C1_Stop();
}

void OLED_SetCursor(uint8_t page, uint8_t column)
{
    OLED_SendCommand_V3(OLED_SET_PAGE_ADDRESS,page,page);

    OLED_SendCommand_V3(OLED_SET_COLUMN_ADDRESS,column,127);
}

void OLED_ClearFrameBuffer(void)
{
    for(uint16_t i =0; i<1024; i++)
    {
        OLED_FrameBuffer[i]=0x00;
    }
}

void OLED_UpdateScreen(void)
{
    OLED_SetCursor(0,0);
    OLED_SendData(OLED_FrameBuffer);
}

const uint8_t *Font5x7_add(char c)
{
    if (c < 32 || c > 126)
    {
        c = '?';
    }

    return &Font5x7[(c - 32) * 5];
}

void OLED_Write(char *ptr)
{

	while(*ptr)
	{
		const uint8_t *x =Font5x7_add(*ptr);
		for(uint8_t i=0; i<5; i++)
		{
			*OLED_BufferPage_ptr = *x;
			OLED_BufferPage_ptr++;
			x++;
		}
		*OLED_BufferPage_ptr = 0x00;
		OLED_BufferPage_ptr++;
		ptr++;
	}

}


void Move_Buffer_ptr(uint8_t page ,uint8_t column)
{
	if(column>=127)
	{
		column=127;
	}
	else if(page>=7)
	{
		page=7;
	}
	OLED_BufferPage_ptr = OLED_Frame_ptr+(page*128);
	OLED_BufferPage_ptr += column;                   // we will move bit by bit not by the character spacing
}

void OLED_DrawHollowSquare(void)
{
    *OLED_BufferPage_ptr++ = 0xFF;
    *OLED_BufferPage_ptr++ = 0x81;
    *OLED_BufferPage_ptr++ = 0x81;
    *OLED_BufferPage_ptr++ = 0x81;
    *OLED_BufferPage_ptr++ = 0x81;
    *OLED_BufferPage_ptr++ = 0xFF;
}

void OLED_DrawFilledSquare(void)
{
    *OLED_BufferPage_ptr++ = 0xFF;
    *OLED_BufferPage_ptr++ = 0xFF;
    *OLED_BufferPage_ptr++ = 0xFF;
    *OLED_BufferPage_ptr++ = 0xFF;
    *OLED_BufferPage_ptr++ = 0xFF;
    *OLED_BufferPage_ptr++ = 0xFF;
}
